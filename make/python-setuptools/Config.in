## make/python-setuptools/Config.in
```kconfig
config FREETZ_PACKAGE_PYTHON_SETUPTOOLS
	bool "setuptools 39.0.1"
	depends on FREETZ_PACKAGE_PYTHON
	default n
	help
		setuptools is a library to setup and explore 
		resources of python packages.
```

## make/python-websocket-client/Config.in
```kconfig
config FREETZ_PACKAGE_PYTHON_WEBSOCKET_CLIENT
	bool "websocket-client 0.47.0"
	depends on FREETZ_PACKAGE_PYTHON
	select FREETZ_LIB_libpython2 if !FREETZ_PACKAGE_PYTHON_STATIC
	select FREETZ_PACKAGE_PYTHON_BACKPORTS_SSL_MATCH_HOSTNAME 
	default n
	help
		WebSocket client for python. hybi13 is supported
```

## make/tar/Config.in
```kconfig
config FREETZ_PACKAGE_TAR
	bool "TAR 1.28 (binary only)"
	default n
	help
		Tar utility.
```

## make/wfrog-ws28xx/Config.in
```kconfig
config FREETZ_PACKAGE_WFROG_WS28XX
	bool "ws28xx master"
	depends on FREETZ_PACKAGE_WFROG
	select FREETZ_PACKAGE_PYTHON_CONFIGOBJ
	default n
	help
		Linux driver based on reverse engineering HeavyWeather 
		software for La Crosse Technology WS-2813U-IT 
		(and perhaps WS-28xx series).
```

## make/wfrog/Config.in
```kconfig
config FREETZ_PACKAGE_WFROG
	bool "wfrog 0.8.2+svn953"
	select FREETZ_PACKAGE_PYTHON
	select FREETZ_PACKAGE_PYTHON_MOD_ELEMENTTREE
	select FREETZ_PACKAGE_PYTHON_MOD_CSV
	select FREETZ_PACKAGE_PYTHON_MOD_JSON
	select FREETZ_PACKAGE_PYTHON_MOD_SYSLOG
	select FREETZ_PACKAGE_PYTHON_MOD_TERMIOS
	select FREETZ_PACKAGE_PYTHON_CHEETAH
	select FREETZ_PACKAGE_PYTHON_LXML
	select FREETZ_PACKAGE_PYTHON_PYGOOGLECHART
	select FREETZ_PACKAGE_PYTHON_PYUSB
	select FREETZ_PACKAGE_PYTHON_PYYAML
	
	default n
	help
		wfrog is a web-based weather station software with nice charts 
		and many ways to publish them on the web, and much more.
```
