## make/pkgs/python-six/Config.in
```kconfig
config FREETZ_PACKAGE_PYTHON_SIX
	bool "six 1.11.0"
	depends on FREETZ_PACKAGE_PYTHON
	default n
	help
		Python 2 and 3 compatibility utilities.
```

## make/pkgs/python-zopecomponent/Config.in
```kconfig
config FREETZ_PACKAGE_PYTHON_ZOPECOMPONENT
	bool "zopecomponent 4.3.0"
	depends on FREETZ_PACKAGE_PYTHON
	default n
	help
		This package represents the core of the 
		Zope Component Architecture. Together with the 
		zope.interface package, it provides facilities 
		for defining, registering and looking up components.
```

## make/pkgs/python-zopeevent/Config.in
```kconfig
config FREETZ_PACKAGE_PYTHON_ZOPEEVENT
	bool "zopeevent 4.3.2"
	depends on FREETZ_PACKAGE_PYTHON
	default n
	help
		This package is an implementation of “object interfaces” 
		for Python. Interfaces are a mechanism for labeling objects 
		as conforming to a given API or contract.
```

## make/pkgs/python-zopeinterface/Config.in
```kconfig
config FREETZ_PACKAGE_PYTHON_ZOPEINTERFACE
	bool "zopeinterface 4.3.2"
	depends on FREETZ_PACKAGE_PYTHON
	default n
	help
		This package provides an implementation 
		of “object interfaces” for Python.
```

## make/pkgs/roundcubemail/Config.in
```kconfig
config FREETZ_PACKAGE_ROUNDCUBEMAIL
	bool "roundcubemail 1.0.9"
	default n
	select FREETZ_PACKAGE_PHP if FREETZ_PACKAGE_ROUNDCUBEMAIL
	select FREETZ_PACKAGE_PHP_WITH_SESSION if FREETZ_PACKAGE_ROUNDCUBEMAIL
	select FREETZ_PACKAGE_PHP_WITH_MEMORY_LIMIT if FREETZ_PACKAGE_ROUNDCUBEMAIL
	select FREETZ_PACKAGE_PHP_WITH_SQLITE3 if FREETZ_PACKAGE_ROUNDCUBEMAIL
	select FREETZ_PACKAGE_PHP_WITH_JSON if FREETZ_PACKAGE_ROUNDCUBEMAIL
	select FREETZ_PACKAGE_PHP_WITH_MCRYPT if FREETZ_PACKAGE_ROUNDCUBEMAIL
	select FREETZ_PACKAGE_PHP_WITH_MHASH if FREETZ_PACKAGE_ROUNDCUBEMAIL
	select FREETZ_PACKAGE_PHP_WITH_FILEINFO if FREETZ_PACKAGE_ROUNDCUBEMAIL
	select FREETZ_PACKAGE_PHP_WITH_SSL if FREETZ_PACKAGE_ROUNDCUBEMAIL
	select FREETZ_PACKAGE_PHP_WITH_LIBXML if FREETZ_PACKAGE_ROUNDCUBEMAIL
	select FREETZ_PACKAGE_PHP_WITH_SOCKETS if FREETZ_PACKAGE_ROUNDCUBEMAIL
	select FREETZ_PACKAGE_PHP_WITH_ZIP if FREETZ_PACKAGE_ROUNDCUBEMAIL
	select FREETZ_PACKAGE_APACHE2 if FREETZ_PACKAGE_ROUNDCUBEMAIL
	select FREETZ_PACKAGE_DOVECOT if FREETZ_PACKAGE_ROUNDCUBEMAIL
	help
		Webmail respectively Webmail configuration page. Accessible
		via the URL http://fritz.box:8081/webmail respetively http://fritz.box:8081/installer,
		it enables you to acccess mail from an IMAP server (Dovecot). This GUI
		needs PHP, so it is automaticaly selected, similarly the web server Apache2.
```

## make/pkgs/tar-cgi/Config.in
```kconfig
config FREETZ_PACKAGE_TAR_CGI
	bool "TAR BACKUP CGI 0.1"
	select FREETZ_BUSYBOX_CUT
	select FREETZ_BUSYBOX_TR
	select FREETZ_BUSYBOX_SED
	select FREETZ_BUSYBOX_FEATURE_IFCONFIG_BROADCAST_PLUS
	default n
	help
		Web configuration interface to backup your data using tar. 
		Which directories are archived or which files are left out 
		can be done using regular expressions
		Freetz web interface to configure your settings.

config FREETZ_PACKAGE_TAR_CGI_WITH_GNUTAR
	depends on FREETZ_PACKAGE_TAR_CGI
	bool "Verify archive with the original files of the file system."
	default n
	select FREETZ_PACKAGE_TAR

config FREETZ_PACKAGE_TAR_CGI_WITH_GNUGZIP
	depends on FREETZ_PACKAGE_TAR_CGI
	bool "Check file integrity of the compressed archive."
	default n
	select FREETZ_PACKAGE_GZIP
```

## make/pkgs/wireguard-linux-compat/Config.in
```kconfig
config FREETZ_PACKAGE_WIREGUARD_LINUX_COMPAT
	bool "wireguard-linux-compat 1.0.20220627"
	depends on FREETZ_PACKAGE_WIREGUARD
	default n
	select FREETZ_MODULE_wireguard
	help
		This package provides the kernel module required for Wireguard

if FREETZ_PACKAGE_WIREGUARD_LINUX_COMPAT

	config FREETZ_PACKAGE_WIREGUARD_LINUX_COMPAT_skb_put_data
		bool
		default y
		depends on \
			FREETZ_AVM_SOURCE_1200_07_14 || \
			FREETZ_AVM_SOURCE_1200_07_27 || \
			FREETZ_AVM_SOURCE_1200_07_50 || \
			FREETZ_AVM_SOURCE_3390_06_51 || \
			FREETZ_AVM_SOURCE_4040_07_01 || \
			FREETZ_AVM_SOURCE_4040_07_14 || \
			FREETZ_AVM_SOURCE_4040_07_29 || \
			FREETZ_AVM_SOURCE_5491_07_01 || \
			FREETZ_AVM_SOURCE_5491_07_27 || \
			FREETZ_AVM_SOURCE_5530_07_29 || \
			FREETZ_AVM_SOURCE_5530_07_50 || \
			FREETZ_AVM_SOURCE_5590_07_29 || \
			FREETZ_AVM_SOURCE_5590_07_50 || \
			FREETZ_AVM_SOURCE_6000_07_27 || \
			FREETZ_AVM_SOURCE_6591_07_04 || \
			FREETZ_AVM_SOURCE_6591_07_13 || \
			FREETZ_AVM_SOURCE_6591_07_50 || \
			FREETZ_AVM_SOURCE_6660_07_26 || \
			FREETZ_AVM_SOURCE_6690_07_29 || \
			FREETZ_AVM_SOURCE_6690_07_56 || \
			FREETZ_AVM_SOURCE_7490_07_01 || \
			FREETZ_AVM_SOURCE_7490_06_51 || \
			FREETZ_AVM_SOURCE_7490_06_83 || \
			FREETZ_AVM_SOURCE_7490_06_93 || \
			FREETZ_AVM_SOURCE_7490_07_01 || \
			FREETZ_AVM_SOURCE_7490_07_11 || \
			FREETZ_AVM_SOURCE_7490_07_27 || \
			FREETZ_AVM_SOURCE_7530_07_02 || \
			FREETZ_AVM_SOURCE_7530_07_20 || \
			FREETZ_AVM_SOURCE_7530_07_25 || \
			FREETZ_AVM_SOURCE_7530_07_50 || \
			FREETZ_AVM_SOURCE_7530_07_56 || \
			FREETZ_AVM_SOURCE_6000_07_27 || \
			FREETZ_AVM_SOURCE_6690_07_29 || \
			FREETZ_AVM_SOURCE_6690_07_56 || \
			FREETZ_AVM_SOURCE_7539_07_29 || \
			FREETZ_AVM_SOURCE_7580_06_53 || \
			FREETZ_AVM_SOURCE_7580_06_81 || \
			FREETZ_AVM_SOURCE_7583_07_10 || \
			FREETZ_AVM_SOURCE_7590_06_92 || \
			FREETZ_AVM_SOURCE_7590_07_01 || \
			FREETZ_AVM_SOURCE_7590_07_25 || \
			FREETZ_AVM_SOURCE_7590_07_50 || \
			FREETZ_AVM_SOURCE_7590_07_56

endif # FREETZ_PACKAGE_WIREGUARD_LINUX_COMPAT
```

## make/python-augeas/Config.in
```kconfig
config FREETZ_PACKAGE_PYTHON_AUGEAS
	bool "augeas 0.5.0"
	depends on FREETZ_PACKAGE_PYTHON
	select FREETZ_LIB_libaugeas
	select FREETZ_LIB_libreadline
	default n
	help
		Pure python bindings for augeas http://augeas.net/.
```

## make/python-backports.ssl_match_hostname/Config.in
```kconfig
config FREETZ_PACKAGE_PYTHON_BACKPORTS_SSL_MATCH_HOSTNAME
	bool "backports.ssl_match_hostname 76440258eb5e"
	depends on FREETZ_PACKAGE_PYTHON
	select FREETZ_LIB_libpython2 if !FREETZ_PACKAGE_PYTHON_STATIC
	default n
```

## make/python-certbot/Config.in
```kconfig
config FREETZ_PACKAGE_PYTHON_CERTBOT
	bool "certbot 1.11.0"
	depends on FREETZ_PACKAGE_PYTHON
	select FREETZ_PACKAGE_PYTHON_AUGEAS
	select FREETZ_PACKAGE_PYTHON_CONFIGARGPARSE
	select FREETZ_PACKAGE_PYTHON_CRYPTOGRAPHY
	select FREETZ_PACKAGE_PYTHON_MOCK
	select FREETZ_PACKAGE_PYTHON_NDG_HTTPSCLIENT
	select FREETZ_PACKAGE_PYTHON_PARSEDATETIME
	select FREETZ_PACKAGE_PYTHON_PYANS1
	select FREETZ_PACKAGE_PYTHON_PYTHONDIALOG
	select FREETZ_PACKAGE_PYTHON_PYRFC3339
	select FREETZ_PACKAGE_PYTHON_PYTZ
	select FREETZ_PACKAGE_PYTHON_REQUESTS
	select FREETZ_PACKAGE_PYTHON_REQUESTSTOOLBELT
	select FREETZ_PACKAGE_PYTHON_SETUPTOOLS
	select FREETZ_PACKAGE_PYTHON_SIX
	select FREETZ_PACKAGE_PYTHON_ZOPECOMPONENT
	select FREETZ_PACKAGE_PYTHON_ZOPEEVENT
	select FREETZ_PACKAGE_PYTHON_ZOPEINTERFACE
	select FREETZ_PACKAGE_PYTHON_JOSEPY
	select FREETZ_PACKAGE_PYTHON_DISTRO
	default n
	help
		certbot is is an easy-to-use client that 
		fetches a certificate from Let’s Encrypt.
```

## make/python-cffi/Config.in
```kconfig
config FREETZ_PACKAGE_PYTHON_CFFI
	bool "cffi 1.8"
	depends on FREETZ_PACKAGE_PYTHON
	depends on FREETZ_LIB_libffi
	select FREETZ_PACKAGE_PYTHON_PLATFORMER
	select FREETZ_PACKAGE_PYTHON_PYCPARSER
	default n
	help
		cffi is a library for testing in Python.
```

## make/python-configargparse/Config.in
```kconfig
config FREETZ_PACKAGE_PYTHON_CONFIGARGPARSE
	bool "configargparse 11.0"
	depends on FREETZ_PACKAGE_PYTHON
	default n
	help
		configargparse is  drop-in replacement for argparse 
		that allows options to also be set via config files 
		and/or environment variables
```

## make/python-cryptography/Config.in
```kconfig
config FREETZ_PACKAGE_PYTHON_CRYPTOGRAPHY
	bool "cryptography 1.5.2"
	depends on FREETZ_PACKAGE_PYTHON
	select FREETZ_PACKAGE_PYTHON_SIX
	select FREETZ_PACKAGE_PYTHON_PYASN1
	select FREETZ_PACKAGE_PYTHON_SETUPTOOLS
	select FREETZ_PACKAGE_PYTHON_CFFI
	select FREETZ_PACKAGE_PYTHON_ENUM34
	select FREETZ_PACKAGE_PYTHON_IPADDRESS
	select FREETZ_PACKAGE_PYTHON_IDNA
	select FREETZ_PACKAGE_PYTHON_MOD_SSL
	default n
	help
		cryptography is a package which provides 
		cryptographic recipes and primitives to 
		Python developers.
```

## make/python-enum34/Config.in
```kconfig
config FREETZ_PACKAGE_PYTHON_ENUM34
	bool "enum34 1.0.4"
	depends on FREETZ_PACKAGE_PYTHON
	default n
	help
		enum34 is an Python 3.4 Enum backport.
```

## make/python-idna/Config.in
```kconfig
config FREETZ_PACKAGE_PYTHON_IDNA
	bool "idna 2.1"
	depends on FREETZ_PACKAGE_PYTHON
	default n
	help
		A library to support the Internationalised Domain Names
		in Applications (IDNA) protocol.
```

## make/python-ipaddress/Config.in
```kconfig
config FREETZ_PACKAGE_PYTHON_IPADDRESS
	bool "ipaddress 1.0.17"
	depends on FREETZ_PACKAGE_PYTHON
	default n
	help
		Python 3.3+'s ipaddress for Python 2.6, 2.7, 3.2.
```

## make/python-josepy/Config.in
```kconfig
config FREETZ_PACKAGE_PYTHON_JOSEPY
	bool "josepy 1.0.1"
	depends on FREETZ_PACKAGE_PYTHON
	select FREETZ_PACKAGE_PYTHON_SIX
	select FREETZ_PACKAGE_PYTHON_CRYPTOGRAPHY
	default n
	help
		JOSE protocol implementation in Python
```

## make/python-lxml/Config.in
```kconfig
config FREETZ_PACKAGE_PYTHON_LXML
	bool "lxml 3.4.0"
	depends on FREETZ_PACKAGE_PYTHON
	select FREETZ_LIB_libxslt
	select FREETZ_LIB_libexslt
	select FREETZ_LIB_libxml2
	default n
	help
		 Powerful and Pythonic XML processing library combining 
		 libxml2/libxslt with the ElementTree API.
```

## make/python-ndg_httpsclient/Config.in
```kconfig
config FREETZ_PACKAGE_PYTHON_NDG_HTTPSCLIENT
	bool "ndg-httpsclient 0.4.2"
	depends on FREETZ_PACKAGE_PYTHON
	select FREETZ_PACKAGE_PYTHON_PYOPENSSL
	default n
	help
		ndg-httpsclient Provides enhanced HTTPS 
		support for httplib and urllib2 using PyOpenSSL.
```

## make/python-parsedatetime/Config.in
```kconfig
config FREETZ_PACKAGE_PYTHON_PARSEDATETIME
	bool "parsedatetime 2.4"
	depends on FREETZ_PACKAGE_PYTHON
	select FREETZ_PACKAGE_PYTHON_FUTURE
	default n
	help
		parsedatetime is a library to parse 
		human-readable date/time strings.
```

## make/python-platformer/Config.in
```kconfig
config FREETZ_PACKAGE_PYTHON_PLATFORMER
	bool "platformer 1.0"
	depends on FREETZ_PACKAGE_PYTHON
	default n
	help
		platformer is a simple and robust way
		to call a C compiler from Python.
```

## make/python-pygooglechart/Config.in
```kconfig
config FREETZ_PACKAGE_PYTHON_PYGOOGLECHART
	bool "pygooglechart 0.3.0"
	depends on FREETZ_PACKAGE_PYTHON
	default n
	help
		 A complete Python wrapper for the Google Chart API.
```

## make/python-pythondialog/Config.in
```kconfig
config FREETZ_PACKAGE_PYTHON_PYTHONDIALOG
	bool "pythondialog 3.4.0"
	depends on FREETZ_PACKAGE_PYTHON
	default n
	help
		pythondialog is to build dialogs for terminal-based applications.
```

## make/python-requeststoolbelt/Config.in
```kconfig
config FREETZ_PACKAGE_PYTHON_REQUESTSTOOLBELT
	bool "request-toolbelt 0.9.1"
	depends on FREETZ_PACKAGE_PYTHON
	select FREETZ_PACKAGE_PYTHON_REQUESTS
	default n
	help
		Requests Toolbelt is a collection of utilities for python-requsts
```

## make/python-samsungctl/Config.in
```kconfig
config FREETZ_PACKAGE_PYTHON_SAMSUNGCTL
	bool "samsungctl 0.7.1"
	depends on FREETZ_PACKAGE_PYTHON
	select FREETZ_PACKAGE_PYTHON_WEBSOCKET_CLIENT
	default n
	help
		Remote control Samsung televisions via a TCP/IP connection.
```
