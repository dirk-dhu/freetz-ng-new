## make/certbot-cgi/Config.in
```kconfig
config FREETZ_PACKAGE_CERTBOT_CGI
	bool "Certbot service 1.0.0"
	select FREETZ_PACKAGE_PYTHON
	select FREETZ_PACKAGE_PYTHON_CERTBOT
	default n
	help
		The certbot configuration CGI with monthly crond


	config FREETZ_PACKAGE_CERTBOT_CGI_WITH_DOMAINNAME
		depends on FREETZ_PACKAGE_CERTBOT_CGI
		string "enter domain name"
		default "fritz.box"

	config FREETZ_PACKAGE_CERTBOT_CGI_WITH_MAILNAME
		depends on FREETZ_PACKAGE_CERTBOT_CGI
		string "enter mail user name"
		default "webmaster"

	config FREETZ_PACKAGE_CERTBOT_CGI_WITH_COUNTRY
		depends on FREETZ_PACKAGE_CERTBOT_CGI
		string "enter country name"
		default "DE"

	config FREETZ_PACKAGE_CERTBOT_CGI_WITH_STATE
		depends on FREETZ_PACKAGE_CERTBOT_CGI
		string "enter state name"
		default ""

	config FREETZ_PACKAGE_CERTBOT_CGI_WITH_HTTP_CHALLENGE
		depends on FREETZ_PACKAGE_CERTBOT_CGI
		bool "support tls-alpn-01, http-01 challenge"
		default ""

	config FREETZ_PACKAGE_CERTBOT_CGI_WITH_DNS_CHALLENGE
		depends on FREETZ_PACKAGE_CERTBOT_CGI
		depends on FREETZ_PACKAGE_DNSMASQ
		bool "suppport dns-01 challenge"
		default ""
		help
			Certbot manual dns hooks are provided,
			an example to spawn a local dns server instance 
			is provided which assume that there is a public dns zone record
			pointing to the _acme-challenge.<DOMAIN> address
			
```

## make/gzip/Config.in
```kconfig
config FREETZ_PACKAGE_GZIP
	bool "GZIP 1.6 (binary only)"
	default n
	help
		Gzip utility.
```

## make/libs/argp-standalone/Config.in
```kconfig
config FREETZ_LIB_libargp_WITH_STATIC
	bool "libargp-standalone (libargp.a)"
	default n
	help
		libargp is a standalone version (static library) of argp
		(arguments parsing functions) from GLIBC.
		It was separated off glibc by Niels M. 
```

## make/libs/libaugeas/Config.in
```kconfig
config FREETZ_LIB_libaugeas
	bool "libaugeas (libaugeas.so)"
	select FREETZ_LIB_libxml2
	select FREETZ_LIB_libreadline
	default n
	help
		Augeas is a library and command line tool that 
		focuses on the most basic problem in handling 
		Linux configurations programmatically: 
		editing actual configuration files in a controlled manner
```

## make/libs/libfmt/Config.in
```kconfig
config FREETZ_LIB_libfmt
	bool "fmt (libfmt.so)"
	default n
	help
		fmt is an open-source formatting library for C++. 
		It can be used as a safe alternative to printf or 
		as a fast alternative to IOStreams.
```

## make/libs/libmcrypt/Config.in
```kconfig
config FREETZ_LIB_libmcrypt
	bool "libmcrypt (libmcrypt.so)"
	default n
	help
		mcrypt, and the accompanying libmcrypt, are intended to be replacements 
		for the old Unix crypt, except
```

## make/libs/pthsem/Config.in
```kconfig
config FREETZ_LIB_libpthsem
	bool "libpthsem (libpthsem.so)"
	default n
	help
		GNU pth is a user mode multi threading library.
		
		pthsem is a fork, with support for semaphores added. It can be 
		installed parallel to a normal pth and provides a compatibilty 
		layer to compile GNU pth programs with pthsem. The header file 
		is called pthsem.h, the configuration programm pthsem-config and 
		the autoconf macro AC_CHECK_PTHSEM. If references to one of these 
		names are changed, pthsem can be used as an replacement of GNU pth. 
```

## make/pkgs/apache2/Config.in
```kconfig
config FREETZ_PACKAGE_APACHE2
	bool "Apache2 2.4.58 (binary only)"
	select FREETZ_LIB_libcrypt        if ! FREETZ_PACKAGE_APACHE2_STATIC && FREETZ_TARGET_UCLIBC_HAS_multiple_libs
	select FREETZ_LIB_libdl           if ! FREETZ_PACKAGE_APACHE2_STATIC && FREETZ_TARGET_UCLIBC_HAS_multiple_libs
	select FREETZ_LIB_libm            if ! FREETZ_PACKAGE_APACHE2_STATIC && FREETZ_TARGET_UCLIBC_HAS_multiple_libs
	select FREETZ_LIB_libapr          if ! FREETZ_PACKAGE_APACHE2_STATIC
	select FREETZ_LIB_libapr_WITH_DSO
	select FREETZ_LIB_libaprutil      if ! FREETZ_PACKAGE_APACHE2_STATIC
	select FREETZ_LIB_libz            if ! FREETZ_PACKAGE_APACHE2_STATIC && FREETZ_PACKAGE_APACHE2_DEFLATE
	select FREETZ_LIB_libcrypto       if ! FREETZ_PACKAGE_APACHE2_STATIC && FREETZ_PACKAGE_APACHE2_SSL
	select FREETZ_LIB_libssl          if ! FREETZ_PACKAGE_APACHE2_STATIC && FREETZ_PACKAGE_APACHE2_SSL
	select FREETZ_LIB_libxml2         if ! FREETZ_PACKAGE_APACHE2_STATIC && FREETZ_PACKAGE_APACHE2_LIBXML
	select FREETZ_LIB_libxml2_WITH_HTML if FREETZ_PACKAGE_APACHE2_LIBXML
	select FREETZ_PACKAGE_PHP_WITH_APACHE2     if FREETZ_PACKAGE_APACHE2_PHP_MOD
	select FREETZ_PACKAGE_APACHE2_MPM_PREFORK  if FREETZ_PACKAGE_APACHE2_PHP_MOD
	select FREETZ_PACKAGE_APACHE2_MPM_WORKER   if ! FREETZ_PACKAGE_APACHE2_PHP_MOD
	select FREETZ_PACKAGE_APACHE2_LIBXML       if FREETZ_PACKAGE_APACHE2_PROXY
	default n
	help
		The Apache httpd server

if FREETZ_PACKAGE_APACHE2

	choice
		prompt "PCRE"
			default FREETZ_PACKAGE_APACHE2_PCRE2

		config FREETZ_PACKAGE_APACHE2_PCRE1
			bool "v1"
			select FREETZ_LIB_libpcre   if !FREETZ_PACKAGE_APACHE2_STATIC

		config FREETZ_PACKAGE_APACHE2_PCRE2
			bool "v2"
			select FREETZ_LIB_libpcre2  if !FREETZ_PACKAGE_APACHE2_STATIC

	endchoice

	config FREETZ_PACKAGE_APACHE2_DEFLATE
		bool "Enable deflate"
		default n
		help
			Enables the deflate compression. Requires libz.

	config FREETZ_PACKAGE_APACHE2_SSL
		bool "Enable SSL"
		default n
		help
			Enables the SSL module. Requires openssl.

	config FREETZ_PACKAGE_APACHE2_PHP_MOD
		bool "Enable PHP Module"
		depends on FREETZ_PACKAGE_APACHE2
		default n
 		help
			Enables the PHP module. Requires php5 module.

	choice
	depends on FREETZ_PACKAGE_APACHE2_PHP_MOD
		prompt "config_mpm"
		default FREETZ_PACKAGE_APACHE2_MPM_PREFORK if FREETZ_PACKAGE_APACHE2_PHP_MOD
		default FREETZ_PACKAGE_APACHE2_MPM_WORKER

		config FREETZ_PACKAGE_APACHE2_MPM_PREFORK
			bool "Prefork"
	#
	#	config FREETZ_PACKAGE_APACHE2_MPM_WORKER
	#		bool "Worker"
	endchoice

	config FREETZ_PACKAGE_APACHE2_MPM
		depends on FREETZ_PACKAGE_APACHE2
		string
		default "prefork" if FREETZ_PACKAGE_APACHE2_MPM_PREFORK
		default "worker"  if FREETZ_PACKAGE_APACHE2_MPM_WORKER

	config FREETZ_PACKAGE_APACHE2_SMALL
		bool "Enable configuration with small memory foot print"
		depends on FREETZ_PACKAGE_APACHE2
		default y
		help
			Changes number of threads and workers in mpm configuration file.

	config FREETZ_PACKAGE_APACHE2_PROXY
		bool "Enable configuration as freetz proxy"
		depends on FREETZ_PACKAGE_APACHE2
		select FREETZ_PACKAGE_APACHE2_LIBXML
		default n
		help
			Adds configuration in order that apache works as freetz proxy.

	config FREETZ_PACKAGE_APACHE2_WITH_MYCONFIG
		bool "Enable additional configuration accessable via web interface"
		depends on FREETZ_PACKAGE_APACHE2
		default n
		help
			Provides additional configuration file, which is accessible via
			freetz web interface to override external access rights and
			other configuration itmes.

	config FREETZ_PACKAGE_APACHE2_SSL
		bool "Enable SSL"
		depends on FREETZ_PACKAGE_APACHE2
		default n
		help
			Enables the SSL module. Requires openssl.

	config FREETZ_PACKAGE_APACHE2_SSL_WITH_CERT
		depends on FREETZ_PACKAGE_APACHE2_SSL
		bool "Create self signed certificate"
		default n
		help
			Creates self signed certificate. Needs the domain name of
			of the web server to be entered.

		config FREETZ_PACKAGE_APACHE2_SSL_CERT_USE_DOMAINNAME
			depends on FREETZ_PACKAGE_APACHE2_SSL_WITH_CERT
			string "enter domain name"
			default "fritz.box"

	config FREETZ_PACKAGE_APACHE2_SSL_WITH_SSLPORT
		depends on FREETZ_PACKAGE_APACHE2_SSL
		string "enter ssl port"
		default "443"
		help
		    Change ssl port to different port, 
		    might be changed in conjunction with SSLH package.

	config FREETZ_PACKAGE_APACHE2_LIBXML
		bool "Enable libxml dependent modules"
		depends on FREETZ_PACKAGE_APACHE2
		default n
		help
			Enables libxml dependent modules. Requires libxml2.

	config FREETZ_PACKAGE_APACHE2_LIBXML
		bool "Enable libxml dependent modules"
		default n
		help
			Enables libxml dependent modules. Requires libxml2.

	config FREETZ_PACKAGE_APACHE2_COMPILEINMODS
		bool "Compile modules in instead of building loadable modules"
		default n
		help
			Causes all apache modules to be linked directly into the main binary.

	config FREETZ_PACKAGE_APACHE2_STATIC
		bool "Link statically"
		default n
		help
			Causes all libraries apache depends on to be linked in statically.

endif # FREETZ_PACKAGE_APACHE2
```

## make/pkgs/dev-tools/Config.in
```kconfig
config FREETZ_PACKAGE_DEV_TOOLS
	bool "Dev Tools  (binary only)"
	depends on (FREETZ_DOWNLOAD_TOOLCHAIN || FREETZ_BUILD_TOOLCHAIN)
	select FREETZ_TARGET_TOOLCHAIN if FREETZ_BUILD_TOOLCHAIN
	select FREETZ_BUSYBOX__DEVELOPER if FREETZ_PACKAGE_DEV_TOOLS && ! FREETZ_PACKAGE_DEV_TOOLS_MINIMAL 
	select FREETZ_BUSYBOX_COMM if FREETZ_PACKAGE_DEV_TOOLS && ! FREETZ_PACKAGE_DEV_TOOLS_MINIMAL
	select FREETZ_PACKAGE_GNU_MAKE if FREETZ_PACKAGE_DEV_TOOLS && ! FREETZ_PACKAGE_DEV_TOOLS_MINIMAL
	select FREETZ_PACKAGE_BASH if FREETZ_PACKAGE_DEV_TOOLS && ! FREETZ_PACKAGE_DEV_TOOLS_MINIMAL
	select FREETZ_PACKAGE_DEV_TOOLS_AUTOCONF if FREETZ_PACKAGE_DEV_TOOLS && FREETZ_PACKAGE_DEV_TOOLS_COMPILER_FULL || FREETZ_PACKAGE_DEV_TOOLS_COMPILER_MOSTLY_NEEDED
	select FREETZ_PACKAGE_DEV_TOOLS_AUTOMAKE if FREETZ_PACKAGE_DEV_TOOLS && FREETZ_PACKAGE_DEV_TOOLS_COMPILER_FULL || FREETZ_PACKAGE_DEV_TOOLS_COMPILER_MOSTLY_NEEDED
	select FREETZ_PACKAGE_DEV_TOOLS_BISON    if FREETZ_PACKAGE_DEV_TOOLS && FREETZ_PACKAGE_DEV_TOOLS_COMPILER_FULL || FREETZ_PACKAGE_DEV_TOOLS_COMPILER_MOSTLY_NEEDED
	select FREETZ_PACKAGE_DEV_TOOLS_FLEX     if FREETZ_PACKAGE_DEV_TOOLS && FREETZ_PACKAGE_DEV_TOOLS_COMPILER_FULL || FREETZ_PACKAGE_DEV_TOOLS_COMPILER_MOSTLY_NEEDED
	select FREETZ_PACKAGE_DEV_TOOLS_M4       if FREETZ_PACKAGE_DEV_TOOLS && FREETZ_PACKAGE_DEV_TOOLS_COMPILER_FULL || FREETZ_PACKAGE_DEV_TOOLS_COMPILER_MOSTLY_NEEDED
	select FREETZ_PACKAGE_DEV_TOOLS_LIBSINCS if FREETZ_PACKAGE_DEV_TOOLS && FREETZ_PACKAGE_DEV_TOOLS_COMPILER_FULL
	default n
	help
		development tools as binutils and gcc,
		used from target toolchain.

menu "further target dev tools"
	depends on FREETZ_PACKAGE_DEV_TOOLS
	source make/pkgs/dev-tools-m4/Config.in.libs
	source make/pkgs/dev-tools-autoconf/Config.in.libs
	source make/pkgs/dev-tools-automake/Config.in.libs
	source make/pkgs/dev-tools-bison/Config.in.libs
	source make/pkgs/dev-tools-flex/Config.in.libs
	source make/pkgs/dev-tools/Config.in.libs
endmenu

comment "Amount of tools selected from the target toolchain -------------"
choice
	prompt "Amount of tools selected"
	depends on FREETZ_PACKAGE_DEV_TOOLS
	default FREETZ_PACKAGE_DEV_TOOLS_MINIMAL
	help
		if choosing compiler you have to enable according external.
		if you change selection you have to select minimal version
		and re-build for cleanup and then choose the wanted item.

	config FREETZ_PACKAGE_DEV_TOOLS_MINIMAL
	bool "minimal (some binaries, compiler is not functional)"
	depends on FREETZ_PACKAGE_DEV_TOOLS

	config FREETZ_PACKAGE_DEV_TOOLS_COMPILER_MOSTLY_NEEDED
	bool "compiler (fully functional, compiler and tools)"
	depends on FREETZ_PACKAGE_DEV_TOOLS

	config FREETZ_PACKAGE_DEV_TOOLS_COMPILER_FULL
	bool "compiler (fully blown set, all incs and libs, SEE HELP)"
	depends on FREETZ_PACKAGE_DEV_TOOLS
	help
		GUI UPLOAD DOES NOT WORK, if selected
		use workaround instead and transfer *.external to fritz.box 
		and unpack file in exteranl directory using tar -xf *.external
		or select create upload file for every package in external menu

	config FREETZ_PACKAGE_DEV_TOOLS_COMPILER_CONFIGURABLE
	bool "compiler (select needed set, yourself)"
	depends on FREETZ_PACKAGE_DEV_TOOLS
endchoice

comment "Install prefix for Compiler Dev-Tools -------------"
	config FREETZ_PACKAGE_DEV_TOOLS_PREFIX
	string 
	depends on FREETZ_PACKAGE_DEV_TOOLS
	default "/usr/local" if !FREETZ_PACKAGE_DEV_TOOLS_MINIMAL
	default "/usr"       if  FREETZ_PACKAGE_DEV_TOOLS_MINIMAL
```

## make/pkgs/dovecot/Config.in
```kconfig
config FREETZ_PACKAGE_DOVECOT
	bool "Dovecot 2.3.21"
	depends on \
		FREETZ_AVM_SOURCE_FOR_SYSTEM_TYPE_UR8  || \
		FREETZ_AVM_SOURCE_FOR_SYSTEM_TYPE_AR9  || \
		FREETZ_AVM_SOURCE_FOR_SYSTEM_TYPE_AR10 || \
		FREETZ_AVM_SOURCE_FOR_SYSTEM_TYPE_IKS  || \
		FREETZ_AVM_SOURCE_FOR_SYSTEM_TYPE_VR9  || \
		FREETZ_AVM_SOURCE_FOR_SYSTEM_TYPE_GRX5
	select FREETZ_LIB_libcrypt                if FREETZ_PACKAGE_DOVECOT && FREETZ_TARGET_UCLIBC_HAS_multiple_libs
	select FREETZ_LIB_libcrypto               if FREETZ_PACKAGE_DOVECOT
	select FREETZ_LIB_libssl                  if FREETZ_PACKAGE_DOVECOT
	select FREETZ_LIB_libcrypto_WITH_ZLIB     if FREETZ_PACKAGE_DOVECOT
	select FREETZ_BUSYBOX_ED                  if FREETZ_PACKAGE_DOVECOT
	select FREETZ_BUSYBOX_START_STOP_DAEMON   if FREETZ_PACKAGE_DOVECOT
	select FREETZ_PACKAGE_DOVECOT_FOR_XMAIL   if FREETZ_PACKAGE_XMAIL
	select FREETZ_BUSYBOX_SYSLOGD             if FREETZ_PACKAGE_DOVECOT_SYSLOG
	select FREETZ_PACKAGE_PHP                 if FREETZ_PACKAGE_DOVECOT_FOR_XMAIL
	default n
	help
		Dovecot is an open source IMAP and POP3 email server for 
		Linux/UNIX-like systems.
		Works with XMail together and can be used with a webmail
		interface as roundcubemail.
		(needs uclibc 1.0.15, because of doveconf panic in memmpool-system.c)

config FREETZ_PACKAGE_DOVECOT_SYSLOG
	bool "syslog"
	depends on FREETZ_PACKAGE_DOVECOT
	default y
	help
		Infos are logged to syslog.

choice
depends on FREETZ_PACKAGE_XMAIL
	prompt "config_for"
	default FREETZ_PACKAGE_DOVECOT_FOR_XMAIL   if FREETZ_PACKAGE_XMAIL

	config FREETZ_PACKAGE_DOVECOT_FOR_XMAIL
		bool "xmail"
endchoice

config FREETZ_PACKAGE_DOVECOT_FOR
	depends on FREETZ_PACKAGE_DOVECOT
	string
	default "xmail"   if FREETZ_PACKAGE_DOVECOT_FOR_XMAIL
```

## make/pkgs/eibd/Config.in
```kconfig
config FREETZ_PACKAGE_EIBD
	bool "EIBD BCUSDK 0.0.5 (KNX/EIB daemon)"
	select FREETZ_LIB_libpthsem
	select FREETZ_LIB_libargp_WITH_STATIC
	select FREETZ_BUSYBOX_START_STOP_DAEMON
	default n
	help
		Free Development Environment for
		Bus Coupling Units of the European
		Installation Bus.
```

## make/pkgs/knxd/Config.in
```kconfig
config FREETZ_PACKAGE_KNXD
	bool "KNXD 0.12.16 (KNX/EIB daemon)"
	select FREETZ_LIB_libev
	select FREETZ_LIB_libfmt
	select FREETZ_BUSYBOX_START_STOP_DAEMON
	default n
	help
		KNX is a very common building automation 
		protocol which runs on dedicated 9600-baud wire 
		as well as IP multicast. knxd is an advanced 
		router/gateway which runs on any Linux computer; 
		it can talk to all known KNX interfaces.
		
		This code is a fork of eibd 0.0.5 (from bcusdk)
```

## make/pkgs/linknx/Config.in
```kconfig
config FREETZ_PACKAGE_LINKNX
	bool "Linknx 0.0.1.37 (KNX/EIB automation platform)"
	select FREETZ_PACKAGE_EIBD
	select FREETZ_LIB_libstdc__
	select FREETZ_LIB_libpthsem
	select FREETZ_LIB_libcurl
	select FREETZ_BUSYBOX_START_STOP_DAEMON
	default n
	help
		Linknx is only one component of a bigger project. 
		The goal is to get the maximum comfort and flexibility 
		from my KNX domotic system while keeping the 
		smallest possible resource consumtion.
		The physical access to the KNX bus is ensured by the 
		EIBD daemon.
```

## make/pkgs/python-asn1crypto/Config.in
```kconfig
config FREETZ_PACKAGE_PYTHON_ASN1CRYPTO
	bool "asn1crypto 0.24.0"
	depends on FREETZ_PACKAGE_PYTHON
	default n
	help
		A fast, pure Python library for 
		parsing and serializing ASN.1 
		structures.
```

## make/pkgs/python-configobj/Config.in
```kconfig
config FREETZ_PACKAGE_PYTHON_CONFIGOBJ
	bool "configobj 5.0.6"
	depends on FREETZ_PACKAGE_PYTHON
	select FREETZ_PACKAGE_PYTHON_SIX
	default n
	help
		 Config file reading, writing and validation.
```

## make/pkgs/python-distro/Config.in
```kconfig
config FREETZ_PACKAGE_PYTHON_DISTRO
	bool "distro 1.5.0"
	depends on FREETZ_PACKAGE_PYTHON
	default n
	help
		Distro an OS platform information API
```
