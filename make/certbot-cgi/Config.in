## make/pkgs/python-future/Config.in
```kconfig
config FREETZ_PACKAGE_PYTHON_FUTURE
	bool "future 0.15.2"
	depends on FREETZ_PACKAGE_PYTHON
	default n
	help
		future is the missing compatibility layer 
		between Python 2 and Python 3. It allows 
		you to use a single, clean Python 3.x-compatible 
		codebase to support both Python 2 and Python 
		3 with minimal overhead.
```

## make/pkgs/python-mock/Config.in
```kconfig
config FREETZ_PACKAGE_PYTHON_MOCK
	bool "mock release-0.8-maint"
	depends on FREETZ_PACKAGE_PYTHON
	default n
	help
		mock is a library for testing in Python.
```

## make/pkgs/python-pyasn1/Config.in
```kconfig
config FREETZ_PACKAGE_PYTHON_PYASN1
	bool "pyasn1 0.1.9"
	depends on FREETZ_PACKAGE_PYTHON
	default n
	help
		pyasn1 is an implementation of ASN.1 types 
		and codecs in Python programming language.
```

## make/pkgs/python-pycparser/Config.in
```kconfig
config FREETZ_PACKAGE_PYTHON_PYCPARSER
	bool "pycparser 2.14"
	depends on FREETZ_PACKAGE_PYTHON
	default n
	help
		pycparser is a parser for the C language, 
		written in pure Python.
```

## make/pkgs/python-pyrfc3339/Config.in
```kconfig
config FREETZ_PACKAGE_PYTHON_PYRFC3339
	bool "pyrfc3339 1.0"
	depends on FREETZ_PACKAGE_PYTHON
	default n
	help
		pyrfc3339 parses and generates RFC 3339-compliant 
		timestamps using Python datetime.datetime objects.
```

## make/pkgs/python-pytz/Config.in
```kconfig
config FREETZ_PACKAGE_PYTHON_PYTZ
	bool "pytz release_2016.7"
	depends on FREETZ_PACKAGE_PYTHON
	default n
	help
		pytz brings the Olson tz database into Python.
```

## make/pkgs/python-pyusb/Config.in
```kconfig
config FREETZ_PACKAGE_PYTHON_PYUSB
	bool "pyusb 1.0.0b2"
	depends on FREETZ_PACKAGE_PYTHON
	select FREETZ_PACKAGE_PYTHON_MOD_CTYPES
	select FREETZ_LIB_libusb_1
	default n
	help
		 Easy USB access on Python.
```

## make/pkgs/python-pyyaml/Config.in
```kconfig
config FREETZ_PACKAGE_PYTHON_PYYAML
	bool "pyyaml 3.11"
	depends on FREETZ_PACKAGE_PYTHON
	select FREETZ_LIB_libyaml
	default n
	help
		 YAML parser and emitter for Python.
```

## make/pkgs/python-requests/Config.in
```kconfig
config FREETZ_PACKAGE_PYTHON_REQUESTS
	bool "requests 2.11.1"
	depends on FREETZ_PACKAGE_PYTHON
	select FREETZ_PACKAGE_PYTHON_MOD_UNICODEDATA
	default n
	help
		Requests is the only Non-GMO HTTP library for Python, 
		safe for human consumption.
```
